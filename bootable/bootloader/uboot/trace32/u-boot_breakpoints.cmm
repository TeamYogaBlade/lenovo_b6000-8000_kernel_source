// T32 Fri Jul 24 11:58:03 2009

 B::
 
 BREAK.RESET
 BREAK.SELECT PROGRAM ONCHIP
 BREAK.SELECT READ ONCHIP
 BREAK.SELECT WRITE ONCHIP
 B.S   reset /P /ONCHIP /DISABLE
 
 ENDDO
