
&UbootImgStart=0x40004000

SYStem.Down
Break.Delete				; Erase default breakpoints
MAP.RESet					; Reset mapping system to default state
sYmbol.RESet                ; All symbols and search paths for source file are cleared
MMU.RESet                   ; The translation table is cleared and all setup's are set to the defaults
SYStem.RESet				; Reset all system settings and switch to down state

System.CPU ARM1176JZ
System.Option Cflush on    	; Flush the cache to avoid data consistency
System.JtagClock 4MHz
System.Option EnReset off

TrOnchip.Set DABORT off     ; Disable for linux page fault handling
TrOnchip.Set PABORT off		; Disable for linux page fault handling
TrOnchip.Set UNDEF off		; Disable for linux pate fault handling
SYStem.Option MMU off

SYStem.Up
Register.REset

SETUP.IMASKASM	ON          ; Disbale interrupt during assembly step
SETUP.IMASKHLL	ON          ; Disbale interrupt during C step

D.S C15:0x1 0				; Turn off MMU

Y.SPATH.RESET ; reset all source path

Y.SPATH.SRD ../board/mt3351
Y.SPATH.SRD ../common
Y.SPATH.SRD ../cpu/arm1136
Y.SPATH.SRD ../drivers/
Y.SPATH.SRD ../include
Y.SPATH.SRD ../lib_arm
Y.SPATH.SRD ../disk
Y.SPATH.SRD ../fs/fat
Y.SPATH.SRD ../fs/fdos
Y.SPATH.SRD ../post
Y.SPATH.SRD ../tools

screen.on
area.reset
print "loading u-boot image"
d.load.binary ../u-boot.bin &UbootImgStart
;d.load.elf ../u-boot /gnu /nocode
;b.s start_armboot /PROGRAM /ONCHIP
r.s pc &UbootImgStart
;go

;wait !run()
do windows.cmm
do u-boot_breakpoints.cmm

